## config/defconfig
```kconfig
CONFIG_VENDOR_ASUS=y
CONFIG_CBFS_SIZE=0x400000
CONFIG_ONBOARD_VGA_IS_PRIMARY=y
CONFIG_BOARD_ASUS_P8H61_M_LX3_R2_0=y
CONFIG_HAVE_IFD_BIN=y
CONFIG_HAVE_ME_BIN=y
CONFIG_NO_GFX_INIT=y
CONFIG_RESOURCE_ALLOCATION_TOP_DOWN=y
CONFIG_PAYLOAD_EDK2=y
CONFIG_EDK2_BOOT_MANAGER_ESCAPE=y
```
